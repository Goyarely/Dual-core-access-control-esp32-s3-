## sdkconfig.defaults
```kconfig
# 硬件基线（N16R8：16MB Flash + 8MB Octal PSRAM）
CONFIG_ESPTOOLPY_FLASHSIZE_16MB=y
CONFIG_ESPTOOLPY_FLASHSIZE="16MB"
CONFIG_SPIRAM=y
CONFIG_SPIRAM_MODE_OCT=y
CONFIG_SPIRAM_SPEED_80M=y
CONFIG_ESP_DEFAULT_CPU_FREQ_MHZ_240=y
CONFIG_COMPILER_OPTIMIZATION_PERF=y

# 分区表
CONFIG_PARTITION_TABLE_CUSTOM=y
CONFIG_PARTITION_TABLE_CUSTOM_FILENAME="partitions.csv"
CONFIG_PARTITION_TABLE_FILENAME="partitions.csv"

# 主任务栈：初始化链会拉起 LVGL/摄像头/协议，留足
CONFIG_ESP_MAIN_TASK_STACK_SIZE=8192

# 人脸检测模型：MSRMNP_S8_V1，模型编译进 app 的 rodata（不占独立分区）
CONFIG_FLASH_HUMAN_FACE_DETECT_MSRMNP_S8_V1=y
CONFIG_HUMAN_FACE_DETECT_MSRMNP_S8_V1=y
CONFIG_HUMAN_FACE_DETECT_MODEL_IN_FLASH_RODATA=y

# LVGL 9：走 Kconfig 配置（不用 lv_conf.h），16 位色
CONFIG_LV_CONF_SKIP=y
CONFIG_LV_COLOR_DEPTH_16=y
CONFIG_LV_MEM_SIZE=65536
CONFIG_LV_USE_LOG=y
CONFIG_LV_FONT_DEFAULT_MONTSERRAT_14=y

# 人脸识别模型：MFN_S8_V1（512 维 int8 embedding），同样编译进 rodata
CONFIG_FLASH_HUMAN_FACE_FEAT_MFN_S8_V1=y
CONFIG_HUMAN_FACE_FEAT_MFN_S8_V1=y
CONFIG_HUMAN_FACE_FEAT_MODEL_IN_FLASH_RODATA=y
```
